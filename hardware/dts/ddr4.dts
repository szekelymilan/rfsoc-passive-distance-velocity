// -------------------------------------------------------------------------------------------------
// Copyright (C) 2023 Advanced Micro Devices, Inc
// SPDX-License-Identifier: MIT
// ---- ---- ---- ---- ---- ---- ---- ---- ---- ---- ---- ---- ---- ---- ---- ---- ---- ---- ---- --

/dts-v1/;
/plugin/;
/ {
        fragment@1 {
                target-path = "/";
                __overlay__ {
                        reserved-memory {
                                #address-cells = <2>;
                                #size-cells = <2>;
                                ranges;

                                pynq_ddr4: buffer@1000000000 {
                                        compatible = "shared-dma-pool";
                                        no-map;
                                        reg = <0x10 0x00000000 0x02 0x00000000>;
                                };

                                reserved_bram: buffer@a0000000 {
                                        reg = <0x00 0xA0000000 0x00 0xA0000>;
                                };
                        };
                };
        };
};
